## board/freescale/mx6qtqcorec/Kconfig
```kconfig
if TARGET_MX6QTQCOREC

config SYS_BOARD
	default "mx6qtqcorec"

config SYS_VENDOR
	default "freescale"

config SYS_CONFIG_NAME
	default "mx6qtqcorec"

endif
```

## board/freescale/tqimx6qcorec/Kconfig
```kconfig
if TARGET_MX6SABRESD

config SYS_BOARD
	default "tqimx6qcorec"

config SYS_VENDOR
	default "freescale"

config SYS_CONFIG_NAME
	default "tqimx6qcorec"

endif
```

## configs/mx6qtqcorec_defconfig
```kconfig
CONFIG_ARM=y
CONFIG_ARCH_MX6=y
CONFIG_TARGET_MX6QTQCOREC=y
CONFIG_SYS_EXTRA_OPTIONS="IMX_CONFIG=board/freescale/mx6qtqcorec/mx6qtqcorec.cfg,MX6Q"
CONFIG_CMD_GPIO=y
```
